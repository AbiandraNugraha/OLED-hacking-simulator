/*INTERNET HACKING SIMULATOR
COPYRIGHT MADE BY ABIANDRA
*/
 */#include <Arduino.h>
#include <U8g2lib.h>
#include <Wire.h>

// Driver SH1106 untuk resolusi 132x64
U8G2_SH1106_128X64_NONAME_F_HW_I2C u8g2(U8G2_R0, /* reset=*/ U8X8_PIN_NONE);

const unsigned char my_earth_bitmap [] PROGMEM = {
  // Masukkan data hex Anda di sini (128x64 tetap bisa digunakan, kita akan menaruhnya di tengah 132)
  0x00, 0x00, 0x00, 0x00, 0x00, 0x00, 0x00, 0x00, 0x00, 0x00, 0x00, 0x00, 0x00, 0x00, 0x00, 0x00, 
  0x00, 0x00, 0x00, 0x00, 0x00, 0x00, 0x00, 0x00, 0x00, 0x00, 0x00, 0x00, 0x00, 0x00, 0x00, 0x00, 
  0x00, 0x00, 0x00, 0x00, 0x10, 0x00, 0x20, 0x00, 0x00, 0x00, 0x00, 0x00, 0x00, 0x00, 0x00, 0x00, 
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  0x20, 0x88, 0x04, 0x01, 0x00, 0x42, 0x11, 0x00, 0x00, 0x00, 0x18, 0x10, 0x00, 0x90, 0x00, 0x00
};

void setup() {
  u8g2.begin();
}

void loop() {

 // --- 2. RANDOM SLIDING SCOPE (3 SECONDS) ---
  int currentX = 66, currentY = 32;               // Start at center
  int targetX = random(20, 110), targetY = random(10, 50); // First random target
  uint32_t searchStartTime = millis();

  while (millis() - searchStartTime < 3000) {
    u8g2.clearBuffer();
    u8g2.drawXBMP(2, 0, 128, 64, my_earth_bitmap); // Map Background centered

    // Slide logic: Move current scope position toward the random target
    if (currentX < targetX) currentX += 3;
    if (currentX > targetX) currentX -= 3;
    if (currentY < targetY) currentY += 3;
    if (currentY > targetY) currentY -= 3;

    // When target is reached, pick a new random spot
    if (abs(currentX - targetX) < 5 && abs(currentY - targetY) < 5) {
      targetX = random(20, 110);
      targetY = random(10, 50);
      delay(50); // Tiny pause at each target point
    }

    // Draw Sliding Scope (Scope shape)
    u8g2.drawCircle(currentX, currentY, 12);
    u8g2.drawLine(currentX - 18, currentY, currentX + 18, currentY);
    u8g2.drawLine(currentX, currentY - 18, currentX, currentY + 18);
    
    // Add "SCANNING" status text
    u8g2.setFont(u8g2_font_5x8_tr);
    u8g2.drawStr(2, 10, "SCANNING...");
    
    u8g2.sendBuffer();
    delay(20); // Adjust speed of sliding here
  }
  // --- 3. FOUND & BLINKING ---
  u8g2.setFont(u8g2_font_6x12_tr);
  for (int i = 0; i < 6; i++) {
    u8g2.clearBuffer();
    u8g2.drawXBMP(2, 0, 128, 64, my_earth_bitmap);
    
    if (i % 2 == 0) {
       u8g2.drawDisc(71, 26, 3); // Titik lokasi
       u8g2.drawStr(28, 60, "Device found");
    }
    u8g2.sendBuffer();
    delay(500);
  }

  // --- 4. STATUS MENYAMBUNG ---
  u8g2.clearBuffer();
  u8g2.drawStr(10, 28, "Connecting");
  u8g2.drawStr(10, 48, "to server...");
  u8g2.sendBuffer();
  delay(3000);
 // --- 5. STATUS SAMBUNGAN ---
  u8g2.clearBuffer();
  u8g2.drawStr(22, 28, "Connected");
  u8g2.drawStr(10, 48, "Addr 192.168.1.4");
  u8g2.sendBuffer();
  delay(2000);
   // --- 6. STATUS PENCARIAN ---
  u8g2.clearBuffer();
  u8g2.drawStr(10, 28, "Tracking location...");
  u8g2.drawStr(10, 48, "");
  u8g2.sendBuffer();
  delay(3000);
   // --- 7. STATUS PENERIMA ---
  u8g2.clearBuffer();
  u8g2.drawStr(10, 28, "Receiving location");
  u8g2.drawStr(10, 48, "data... 5%");
  u8g2.sendBuffer();
  delay(500);
 // --- 8. STATUS PENERIMA ---
  u8g2.clearBuffer();
  u8g2.drawStr(10, 28, "Receiving location");
  u8g2.drawStr(10, 48, "data... 47%");
  u8g2.sendBuffer();
  delay(400); // --- 9. STATUS PENERIMA ---
  u8g2.clearBuffer();
  u8g2.drawStr(10, 28, "Receiving location");
  u8g2.drawStr(10, 48, "data... 51%");
  u8g2.sendBuffer();
  delay(900); // --- 10. STATUS PENERIMA ---
  u8g2.clearBuffer();
  u8g2.drawStr(10, 28, "Receiving location");
  u8g2.drawStr(10, 48, "data... 80%");
  u8g2.sendBuffer();
  delay(500); // --- 11. STATUS PENERIMA ---
  u8g2.clearBuffer();
  u8g2.drawStr(10, 28, "Receiving location");
  u8g2.drawStr(10, 48, "data... 99%");
  u8g2.sendBuffer();
  delay(300);

   // --- 12. STATUS DITEMUKAN---
  u8g2.clearBuffer();
  u8g2.drawStr(22, 28, "Found.");
  u8g2.drawStr(10, 48, "");
  u8g2.sendBuffer();
  delay(1500);



  // --- 13. KOORDINAT AKHIR ---
  u8g2.clearBuffer();
  u8g2.setFont(u8g2_font_5x8_tr); // Font lebih kecil agar muat
  u8g2.drawStr(15, 20, "Coordinate:");
  u8g2.setFont(u8g2_font_6x12_tr);
  u8g2.drawStr(25, 40, "3°28'21.4 S");
  u8g2.drawStr(25, 55, "114°48'34.3 E");
  u8g2.sendBuffer();

  while(1); // Selesai
}
